// SPDX-License-Identifier: (GPL-2.0+ OR MIT)
/dts-v1/;

#include "meson-sm1.dtsi"
#include "meson-libretech-cottonwood-cm.dtsi"
#include "meson-sm1-libretech-cottonwood-cm.dtsi"
#include "meson-g12-vendor-firmware.dtsi"

/ {
	compatible = "libretech,aml-s905d3-cm", "amlogic,sm1";
	model = "Libre Computer AML-S905D3-CM";
};

/ {
	reserved-memory {
		linux,cma {
			/*
			 * AML-S905D3-CM comes in up to 4 GiB RAM variants. Set CMA
			 * to 896 MiB (max formula for 4 GiB). U-boot caps to
			 * min(DT, calculated) based on detected RAM.
			 */
			size = <0x0 0x38000000>;
		};
	};
};
