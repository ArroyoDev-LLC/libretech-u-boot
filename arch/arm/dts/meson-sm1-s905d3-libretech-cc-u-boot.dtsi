// SPDX-License-Identifier: (GPL-2.0+ OR MIT)
/*
 * U-Boot additions for meson-sm1-s905d3-libretech-cc.dts (vendor chain):
 * the shared S905D3-CC additions plus the SPI NOR / 4-bit eMMC split.
 */

#include "meson-sm1-s905d3-libretech-cc-common-u-boot.dtsi"
#include "meson-sm1-s905d3-libretech-cc-nor-u-boot.dtsi"
