## drivers/dfu/Kconfig
```kconfig
menu "DFU support"

config DFU
	bool
	imply DFU_OVER_USB if USB_GADGET

config DFU_OVER_USB
	bool
	select HASH
	depends on USB_GADGET_DOWNLOAD

config DFU_OVER_TFTP
	bool
	depends on NET_LEGACY

config DFU_WRITE_ALT
	bool

if DFU
config DFU_TFTP
	bool "DFU via TFTP"
	depends on NETDEVICES
	depends on !NET_LWIP
	select UPDATE_COMMON
	select DFU_OVER_TFTP
	help
	  This option allows performing update of DFU-managed medium with data
	  sent via TFTP boot.

	  Detailed description of this feature can be found at ./doc/README.dfutftp

config DFU_TIMEOUT
	bool "Timeout waiting for DFU"
	help
	  This option adds an optional timeout parameter for DFU which, if set,
	  will cause DFU to only wait for that many seconds before exiting.

config DFU_TRANSFER_SIZE
	int "DFU over USB transfer size (wTransferSize)"
	range 4096 65535
	default 4096
	help
	  The most bytes one DFU DNLOAD or UPLOAD request carries, as the DFU
	  functional descriptor's wTransferSize tells the host.  Every block
	  is a control transfer followed by a GETSTATUS round trip, so a
	  bigger block costs fewer round trips per byte.  Keep it a multiple
	  of 512, the SuperSpeed EP0 packet: DWC3 bounces an OUT data stage
	  that is not whole packets through a 512-byte buffer.  The composite
	  gadget's EP0 buffer is sized to hold one block.

config DFU_BULK
	bool "DFU bulk data path for RAM alternates (vendor extension)"
	depends on DFU_OVER_USB
	help
	  Adds a vendor interface with a bulk IN and a bulk OUT endpoint
	  beside the DFU interface.  A host that knows it arms a download or
	  upload of whole 64 KiB units on the selected alternate with a
	  vendor request, and the units move over bulk straight to or from
	  RAM (alternates with a direct buffer only: DFU_RAM's plain layout).
	  EP0 control transfers are paced per 64-byte packet at high speed,
	  which caps DFU near 12 MiB/s; bulk is not.  The rest of the
	  protocol is DFU's own, so dfu-util and other hosts are unaffected.

config SPL_DFU_BULK
	bool "DFU bulk data path in SPL"
	depends on SPL_DFU && DFU_BULK
	help
	  DFU_BULK in the SPL's DFU session.

config DFU_MMC
	bool "MMC back end for DFU"
	depends on MMC
	help
	  This option enables using DFU to read and write to MMC based storage.

config DFU_MTD
	bool "MTD back end for DFU"
	depends on DM_MTD
	help
	  This option enables using DFU to read and write to on any MTD device.

config DFU_NAND
	bool "NAND back end for DFU"
	depends on CMD_MTDPARTS
	depends on MTD_RAW_NAND
	help
	  This option enables using DFU to read and write to NAND based
	  storage.

config DFU_NAND_TRIMFFS
	bool "Skip empty pages when flashing UBI images to NAND"
	depends on DFU_NAND
	help
	  When flashing UBI images to NAND, enable the DROP_FFS flag to drop
	  trailing all-0xff pages.

config DFU_RAM
	bool "RAM back end for DFU"
	help
	  This option enables using DFU to read and write RAM on the target.

config DFU_RAM_LZMA
	bool "DFU RAM: the lzma layout, unpacked while the download runs"
	depends on DFU_RAM && LZMA
	default y
	help
	  `<name> lzma <addr> <size> <staging>` alternates: the host sends an
	  LZMA ("alone") stream and the board unpacks it into <addr> as it
	  arrives. Off, the layout is refused and its code is not built.

config SPL_DFU_RAM_LZMA
	bool "DFU RAM lzma layout in SPL"
	depends on SPL_DFU && SPL_LZMA
	default y
	help
	  DFU_RAM_LZMA in the SPL's DFU session. A board whose SPL decodes an
	  LZMA FIT keeps SPL_LZMA and may still turn this off: the decoder
	  stays, the streaming layout goes.

config DFU_SF
	bool "SPI flash back end for DFU"
	depends on SPI_FLASH || DM_SPI_FLASH
	help
	  This option enables using DFU to read and write to SPI flash based
	  storage.

config DFU_SF_PART
	bool "MTD partition support for SPI flash back end"
	depends on DFU_SF && CMD_MTDPARTS
	default y
	help
	  This option enables the support of "part" and "partubi" target in
	  SPI flash DFU back end.

config DFU_VIRT
	bool "VIRTUAL flash back end for DFU"
	help
	  This option enables using DFU to read and write to VIRTUAL device
	  used at board level to manage specific behavior
	  (OTP update for example).

config DFU_SCSI
	bool "SCSI flash back end for DFU"
	help
	  This option enables using DFU to read and write to SCSI devices
	  used at board level to manage specific behavior
	  (OTP update for example).

config SET_DFU_ALT_INFO
	bool "Dynamic set of DFU alternate information"
	depends on !COMPILE_TEST
	help
	  This option allows to call the function set_dfu_alt_info to
	  dynamically build dfu_alt_info in board.

config SYS_DFU_DATA_BUF_SIZE
	hex "Size of buffer to be allocated for transfer to raw storage device"
	default 0x800000
	help
	  DFU transfer uses a buffer before writing data to the
	  raw storage device. This value can be used for setting the
	  size of this buffer. The size of the buffer is also configurable
	  through the "dfu_bufsiz" environment variable. If both are
	  given the size of the buffer is set to "dfu_bufsize".

config SYS_DFU_MAX_FILE_SIZE
	hex "Size of the buffer to be allocated for transferring files"
	default SYS_DFU_DATA_BUF_SIZE
	help
	  When updating files rather than the raw storage device,
	  we use a static buffer to copy the file into and then write
	  the buffer once we've been given the whole file.  Define
	  this to the maximum filesize (in bytes) for the buffer.
	  If undefined it defaults to the CONFIG_SYS_DFU_DATA_BUF_SIZE.

config DFU_NAME_MAX_SIZE
	int "Size of the name to be added in dfu entity"
	default 32
	depends on DFU
	help
	  This value is used to maximum size. If name is longer than default size,
	  we need to change the proper maximum size.

endif
endmenu
```

## drivers/firmware/scmi/Kconfig
```kconfig
config SCMI_FIRMWARE
	bool "Enable SCMI support"
	select FIRMWARE
	select OF_TRANSLATE
	depends on SANDBOX || DM_MAILBOX || ARM_SMCCC || OPTEE
	depends on OF_CONTROL
	help
	  System Control and Management Interface (SCMI) is a communication
	  protocol that defines standard interfaces for power, performance
	  and system management. The SCMI specification is available at
	  https://developer.arm.com/architectures/system-architectures/software-standards/scmi

	  An SCMI agent communicates with a related SCMI server firmware
	  located in another sub-system, as a companion micro controller
	  or a companion host in the CPU system.

	  Communications between agent (client) and the SCMI server are
	  based on message exchange. Messages can be exchanged over transport
	  channels as a mailbox device or an Arm SMCCC service with some
	  piece of identified shared memory.


config SCMI_BASE_PROBE_OPTIONAL
	bool "Soft-fail SCMI Base protocol probe"
	depends on SCMI_FIRMWARE
	help
	  If Base protocol version discover fails (e.g. mute SC / mailbox
	  timeout), warn and continue board init instead of failing the
	  SCMI agent bind (which aborts initr_dm). This is the soft-fail
	  only: it prints nothing beyond the failure itself and changes no
	  clock or OPP. A shipping board whose SC may be mute (e.g. the
	  S905D3 open-SC chain) needs it; the residual / bring-up banner
	  is the separate SCMI_RESIDUAL_DIAG.

	  Note: scmi_bind_protocols() currently returns 0 on a failed
	  BASE probe / base-info read unconditionally (needed on
	  ROC-RK3399-PC too), so this symbol declares the board's
	  soft-fail requirement and is the dependency of
	  SCMI_RESIDUAL_DIAG; it gates no output of its own.

config SCMI_RESIDUAL_DIAG
	bool "Residual / bring-up SCMI diagnostic banner and raw probes"
	depends on SCMI_BASE_PROBE_OPTIONAL
	default n
	help
	  Residual / open-SC bring-up diagnostics: the "SCMI: ..." UART
	  banner during agent bind (SC heartbeat / stack-paint / CPU-power
	  words, protocol list, sensor read, the PERF / CLOCK round-trip
	  that flips the CPU to the other OPP and back with mdelay waits,
	  the power-domain probe), the MHU/SMT dump on a failed response,
	  the simple-CLI interactive loop, and the raw `scmi rd reset`
	  command. Adds boot time and changes the CPU clock transiently.
	  Never enable in a product defconfig.

config SCMI_AGENT_MAILBOX
	bool "Enable SCMI agent mailbox"
	depends on SCMI_FIRMWARE && DM_MAILBOX
	default y
	help
	  Enable the SCMI communication channel based on mailbox
	  for compatible "arm,scmi".

config SCMI_AGENT_SMCCC
	bool "Enable SCMI agent SMCCC"
	depends on SCMI_FIRMWARE && ARM_SMCCC
	default y
	help
	  Enable the SCMI communication channel based on Arm SMCCC service for
	  compatible "arm,scmi-smc".

config SCMI_AGENT_OPTEE
	bool "Enable SCMI agent OP-TEE"
	depends on SCMI_FIRMWARE && OPTEE
	default y
	help
	  Enable the SCMI communication channel based on OP-TEE transport
	  for compatible "linaro,scmi-optee".

config SCMI_ID_VENDOR_80
	bool

config SCMI_ID_VENDOR_82
	bool

source "drivers/firmware/scmi/vendors/imx/Kconfig"
```

## drivers/firmware/scmi/vendors/libre/Kconfig
```kconfig
config SCMI_LC_TYPEC
	bool "Libre Computer lc-typec SCMI vendor protocol 0x80"
	depends on SCMI_FIRMWARE && ROCKCHIP_RK3399
	select SCMI_ID_VENDOR_80
	help
	  The RK3399 Cortex-M0 SCMI server can own the rear Type-C0 port
	  (sole I2C7 master, sink policy engine) and reports it through the
	  vendor protocol 0x80 "lc-typec". With this option U-Boot takes the
	  bind-time ownership decision, keeps its own fusb302 TCPM and the
	  I2C7 controller off that port when the M0 owns it, feeds the
	  Type-C PHY the orientation the M0 reports, and adds
	  `scmi typec status`. A server without 0x80 leaves everything as
	  before.
```

## drivers/input/Kconfig
```kconfig
config INPUT
	bool "Enable input subsystem"
	depends on DM
	default y

config SPL_INPUT
	bool "Enable input subsystem for SPL"
	depends on SPL_DM

config TPL_INPUT
	bool "Enable input subsystem for TPL"
	depends on TPL_DM

config DM_KEYBOARD
	bool "Enable driver model keyboard support"
	depends on DM
	help
	  This adds a uclass for keyboards and implements keyboard support
	  using driver model. The API is implemented by keyboard.h and
	  includes methods to start/stop the device, check for available
	  input and update LEDs if the keyboard has them.

config SPL_DM_KEYBOARD
	bool "Enable driver model keyboard support for SPL"
	depends on SPL_DM
	help
	  This adds a uclass for keyboards and implements keyboard support
	  using driver model. The API is implemented by keyboard.h and
	  includes methods to start/stop the device, check for available
	  input and update LEDs if the keyboard has them.

config TPL_DM_KEYBOARD
	bool "Enable driver model keyboard support for TPL"
	depends on TPL_DM
	help
	  This adds a uclass for keyboards and implements keyboard support
	  using driver model. The API is implemented by keyboard.h and
	  includes methods to start/stop the device, check for available
	  input and update LEDs if the keyboard has them.

config APPLE_SPI_KEYB
	bool "Enable Apple SPI keyboard support"
	depends on DM_KEYBOARD && DM_SPI
	help
	  This adds a driver for the keyboards found on various
	  laptops based on Apple SoCs. These keyboards use an
	  Apple-specific HID-over-SPI protocol.

config BUTTON_KEYBOARD
	bool "Buttons as keyboard"
	depends on DM_KEYBOARD && DM_GPIO
	select BUTTON
	select BUTTON_GPIO
	help
	  Enable support for mapping buttons to keycode events. Use linux,code button driver
	  dt node to define button-event mapping.
	  For example, an arrows and enter may be implemented to navigate boot menu.

config TOUCH_KEYBOARD
	bool "Touchscreen zones as keyboard"
	depends on DM_KEYBOARD && DM_SPI && DM_GPIO
	help
	  Present an XPT2046/ADS7846 resistive touch panel as a keyboard, so
	  that stdin consumers become touch-navigable without knowing anything
	  about touch. The panel is split into a five-zone cross and each zone
	  emits one keycode: top/bottom/left/right give the arrow keys and the
	  centre gives enter, which is what the bootmenu needs to be driven by
	  finger alone.

	  Keys are emitted when the finger LIFTS, so a held finger produces one
	  keypress rather than an auto-repeat storm. Polling reads the pendown
	  GPIO first and only touches the SPI bus while a finger is down, so
	  the console's continuous tstc() does not monopolise a bus that is
	  typically shared with the display.

	  The driver binds to the "ti,ads7846" node; without it (or without the
	  overlay that supplies it) nothing is registered.

config CPCAP_POWER_BUTTON
	bool "Enable power button of CPCAP PMIC support"
	depends on DM_KEYBOARD && DM_PMIC_CPCAP
	help
	  Enable support for a dedicated power button of the CPCAP PMIC.

config CROS_EC_KEYB
	bool "Enable Chrome OS EC keyboard support"
	depends on INPUT && CROS_EC
	help
	  Most ARM Chromebooks use an EC to provide access to the keyboard.
	  Messages are used to request key scans from the EC and these are
	  then decoded into keys by this driver.

config SPL_CROS_EC_KEYB
	bool "Enable Chrome OS EC keyboard support in SPL"
	depends on SPL_INPUT && SPL_CROS_EC
	help
	  Most ARM Chromebooks use an EC to provide access to the keyboard.
	  Messages are used to request key scans from the EC and these are
	  then decoded into keys by this driver.

config TPL_CROS_EC_KEYB
	bool "Enable Chrome OS EC keyboard support in TPL"
	depends on TPL_INPUT && TPL_CROS_EC
	help
	  Most ARM Chromebooks use an EC to provide access to the keyboard.
	  Messages are used to request key scans from the EC and these are
	  then decoded into keys by this driver.

config I8042_KEYB
	bool "Enable Intel i8042 keyboard support"
	depends on DM_KEYBOARD
	default X86
	help
	  This adds a driver for the i8042 keyboard controller, allowing the
	  keyboard to be used on devices which support this controller. The
	  driver handles English and German keyboards - set the environment
	  variable 'keymap' to "de" to select German. Keyboard repeat is
	  handled by the keyboard itself.

config TEGRA_KEYBOARD
	bool "NVIDIA Tegra internal matrix keyboard controller support"
	depends on ARCH_TEGRA
	help
	  A matrix keyboard connected directly to the internal keyboard
	  controller on Tegra SoCs.

config TWL4030_INPUT
	bool "Enable TWL4030 Input controller"
	help
	  Enable TWL4030 Input controller
```
