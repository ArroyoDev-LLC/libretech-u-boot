## drivers/net/wireless/mt7601u/Kconfig
```kconfig
config WIFI_MT7601U
	bool "MediaTek MT7601U USB Wi-Fi background scan (EXPERIMENTAL)"
	depends on USB_XHCI_HCD && CYCLIC
	select USB_XHCI_ASYNC_BULK
	select SHA1
	select AES
	default n
	help
	  EXPERIMENTAL. Port of the Linux mt7601u driver: finds an MT7601U USB
	  dongle, uploads its MCU firmware, initialises MAC/BBP/RF for 20 MHz on
	  2.4 GHz, and adds a 'wifi' command. 'scan start' registers a
	  CONFIG_CYCLIC function that hops channels 1-11 while U-Boot sits at its
	  prompt, filling a BSS table from beacons and probe responses.
	  'join <ssid>' takes a scanned BSS through 802.11 authentication,
	  association and, for a WPA2-PSK network, the four-way handshake
	  (passphrase from the 'wifi_pass' environment variable), installing the
	  pairwise and group keys so U-Boot's net stack can run over the link.
	  It joins the operator's own network as a station.

	  Both bulk-IN endpoints are driven by the xHCI non-blocking TD API
	  (USB_XHCI_ASYNC_BULK); cancelling an in-flight bulk IN wedges this
	  dongle's USB RX DMA, so the TDs are never cancelled per poll.

	  For development and bring-up only. No board enables it by default.

config WIFI_MT7601U_FIRMWARE_PATH
	string "MT7601U firmware file to link in"
	depends on WIFI_MT7601U
	default "/lib/firmware/mt7601u.bin"
	help
	  Absolute path, on the build host, of the linux-firmware mt7601u.bin
	  (45412 bytes). It is embedded with .incbin at build time; the build
	  fails with "No rule to make target '<path>'" if the file is absent.
	  No firmware binary is kept in the U-Boot tree.
```

## drivers/ram/rockchip/Kconfig
```kconfig
config RAM_ROCKCHIP
	bool "Ram drivers support for Rockchip SoCs"
	depends on RAM && ARCH_ROCKCHIP
	default y
	help
	  This enables support for ram drivers Rockchip SoCs.

config ROCKCHIP_SDRAM_COMMON
	bool "Enable rockchip sdram common driver"
	depends on TPL_RAM || SPL_RAM
	help
	  This enable sdram common driver

if RAM_ROCKCHIP

config RAM_ROCKCHIP_DEBUG
	bool "Rockchip ram drivers debugging"
	depends on DEBUG_UART
	default y
	help
	  This enables debugging ram driver API's for the platforms
	  based on Rockchip SoCs.

	  This is an option for developers to understand the ram drivers
	  initialization, configurations and etc.

config RAM_ROCKCHIP_RK3328_FALLBACK
	bool "RK3328: step down to the DDR4-666 parameter set on a training failure"
	depends on ROCKCHIP_RK3328
	help
	  When training at the board's rockchip,sdram-params fails, TPL
	  reinitialises the DRAM with the DDR4 333 MHz (DDR-666) set and prints
	  "DDR: WARNING clock fallback"; both failing is a printed DRAM init
	  failure. The set is the one rk3328-sdram-ddr4-666.dtsi uses, from
	  asm/arch-rockchip/sdram_rk3328_ddr4_666.h, compiled into the TPL
	  rather than carried in the DMC's platdata: the platdata is copied into
	  the TPL's early heap at bind, which has no room for a second set.
	  Select only for a DDR4 board whose configured set runs faster.

config RAM_ROCKCHIP_DDR4
	bool "DDR4 support for Rockchip SoCs"
	help
	  This enables DDR4 sdram support instead of the default DDR3 support
	  on Rockchip SoCs.

config RAM_ROCKCHIP_LPDDR2
	bool "LPDDR2 support for Rockchip SoCs"
	help
	  This enables LPDDR2 sdram support instead of the default DDR3 support
	  on Rockchip SoCs.

config RAM_ROCKCHIP_LPDDR3
	bool "LPDDR3 support for Rockchip SoCs"
	help
	  This enables LPDDR3 sdram support instead of the default DDR3 support
	  on Rockchip SoCs.

config RAM_ROCKCHIP_LPDDR4
	bool "LPDDR4 support for Rockchip SoCs"
	help
	  This enables LPDDR4 sdram code support for the platforms based
	  on Rockchip SoCs.

endif # RAM_ROCKCHIP
```
