## drivers/usb/mtu3/Kconfig
```kconfig
# SPDX-License-Identifier: GPL-2.0
#
# For MTK USB3.0 IP

config USB_MTU3
	bool "MediaTek USB3 Dual Role controller"
	depends on USB_XHCI_HCD || USB_GADGET
	depends on ARCH_MEDIATEK
	help
	  Say Y here if your system runs on MediaTek SoCs with
	  Dual Role SuperSpeed USB controller. You can select usb
	  mode as peripheral role or host role.

	  If you don't know what this is, please say N.

if USB_MTU3
choice
	bool "MTU3 Mode Selection"
	default USB_MTU3_GADGET if USB_GADGET
	default USB_MTU3_HOST if (USB_HOST && !USB_GADGET)

config USB_MTU3_HOST
	bool "Host only mode"
	depends on USB_XHCI_HCD
	help
	  Select this when you want to use MTU3 in host mode only,
	  thereby the gadget feature will be regressed.

config USB_MTU3_GADGET
	bool "Gadget only mode"
	depends on USB_GADGET
	select USB_GADGET_DUALSPEED
	help
	  Select this when you want to use MTU3 in gadget mode only,
	  thereby the host feature will be regressed.

endchoice

config USB_MTU3_XHCI_CHILD
	bool "Bind the nested mtk-xhci host child of the mtu3 glue"
	depends on USB_XHCI_MTK
	help
	  The upstream device trees nest an "mediatek,mtk-xhci" host node
	  under the "mediatek,mtu3" glue (mt8183 usb_host, mt8188 xhci0..2).
	  This glue supplies its own .bind, so the DM never scans that child
	  and the standalone xhci-mtk driver never binds -- usb_init() then
	  reports no working controllers even with USB_XHCI_MTK enabled.

	  Say Y to bind xhci-mtk on that child, giving the DFU/UMS gadget and
	  the xhci host on the one SSUSB, without any -u-boot.dtsi surgery.

	  This is opt-in per board because it adds a USB controller that a
	  BOOT_TARGET_USB distro scan will probe at autoboot. Enable it only
	  on boards where the host path has been validated on hardware.

	  If unsure, say N.

config USB_MTU3_DEBUG
	bool "Enable Debugging Messages"
	help
	  Say Y here to enable debugging messages in the MTU3 Driver.

endif
```

## drivers/usb/tcpm/Kconfig
```kconfig
# SPDX-License-Identifier: GPL-2.0

config TYPEC_TCPM
	tristate "USB Type-C Port Controller Manager"
	depends on DM
	help
	  The Type-C Port Controller Manager provides a USB PD and USB Type-C
	  state machine for use with Type-C Port Controllers.

config TYPEC_DISPLAYPORT
	bool "DisplayPort Alt Mode on USB Type-C"
	depends on TYPEC_TCPM
	help
	  DisplayPort Alt Mode, source side: discover the partner's alt
	  modes, enter DisplayPort, and negotiate a pin assignment. Uses the
	  Type-C Port Controller Manager's VDM transport; the negotiated pin
	  assignment then has to be handed to the board's Type-C PHY.

	  Needed to drive a display over a USB-C connector. Say N if the
	  board's DisplayPort output is a dedicated connector.

config SPL_TYPEC_FUSB302_CC
	bool "FUSB302 plug orientation in SPL"
	depends on SPL_DM_I2C
	help
	  Measure the CC lines of an FUSB302 once in SPL to learn which way
	  round the Type-C plug is, without the port manager. A Type-C PHY
	  that carries SuperSpeed in SPL needs it to map its lanes; without
	  it the PHY assumes a normal plug and a reversed one links at high
	  speed only.

config TYPEC_FUSB302
	tristate "Fairchild FUSB302 Type-C chip driver"
	depends on DM && DM_I2C && TYPEC_TCPM
	help
	  The Fairchild FUSB302 Type-C chip driver that works with
	  Type-C Port Controller Manager to provide USB PD and USB
	  Type-C functionalities.
```

## drivers/video/rockchip/Kconfig
```kconfig
#
# Video drivers selection for rockchip soc. These configs only impact the
# compile process. You can surely check all the options. In this case, all the
# display driver will be compiled, but which drivers finally  will be used is
# decided by device tree configuration. What's more, enable needed power for
# display by configure the device tree, and the vop driver will do the rest.
#
# Author: Eric Gao <eric.gao@rock-chips.com>
#

menuconfig VIDEO_ROCKCHIP
	bool "Enable Rockchip Video Support"
	depends on VIDEO && ARCH_ROCKCHIP
	imply VIDEO_DAMAGE
	help
	  Rockchip SoCs provide video output capabilities for High-Definition
	  Multimedia Interface (HDMI), Low-voltage Differential Signalling
	  (LVDS), embedded DisplayPort (eDP) and Display Serial Interface (DSI).

	  This driver supports the on-chip video output device, and targets the
	  Rockchip RK3288 and RK3399.

config VIDEO_ROCKCHIP_MAX_XRES
        int "Maximum horizontal resolution (for memory allocation purposes)"
	depends on VIDEO_ROCKCHIP
	default 3840 if DISPLAY_ROCKCHIP_HDMI
	default 1920
	help
	  The maximum horizontal resolution to support for the framebuffer.
	  This configuration is used for reserving/allocating memory for the
	  framebuffer during device-model binding/probing.

config VIDEO_ROCKCHIP_MAX_YRES
        int "Maximum vertical resolution (for memory allocation purposes)"
	depends on VIDEO_ROCKCHIP
	default 2160 if DISPLAY_ROCKCHIP_HDMI
	default 1080
	help
	  The maximum vertical resolution to support for the framebuffer.
	  This configuration is used for reserving/allocating memory for the
	  framebuffer during device-model binding/probing.

if VIDEO_ROCKCHIP

config DISPLAY_ROCKCHIP_DP
	bool "Cadence MHDP DisplayPort"
	depends on VIDEO_ROCKCHIP && ROCKCHIP_RK3399
	help
	  This enables the Cadence MHDP DisplayPort controller found on the
	  RK3399 (cdn-dp), driving DP out of a Type-C port.

	  This controller has no host-driven register interface for link
	  training: a ucpu embedded in it runs a firmware image, and the host
	  talks to that firmware over a mailbox. Without the firmware there is
	  no AUX, no DPCD, no EDID and no link.

choice
	prompt "cdn-dp ucpu firmware source"
	depends on DISPLAY_ROCKCHIP_DP
	default CDN_DP_FW_FIT
	help
	  Where rockchip/dptx.bin comes from. There is deliberately NO runtime
	  fallback between these: a silent fall back to a network fetch would
	  hide a corrupt NOR image behind a working display, which is the one
	  failure mode a bring-up must never mask.

config CDN_DP_FW_FIT
	bool "FIT image node, decompressed by SPL"
	depends on SPL_LOAD_FIT && SPL_LZMA
	help
	  Ship dptx.bin as an LZMA-compressed node in u-boot.itb. SPL already
	  reads, sha256-verifies and LZMA-decompresses U-Boot from that same
	  FIT, so this reuses machinery that exists: U-Boot proper does no FIT
	  parsing, no 'sf read' and no binman lookup -- it reads the blob where
	  SPL left it, at CDN_DP_FW_FIT_ADDR.

	  Costs about 33 KB of the SPI NOR budget rather than the blob's full
	  98,320 bytes (measured: u-boot.itb 896,000 compressed vs 961,536
	  uncompressed, with BL31 present). Needs no operator step, no network
	  and no storage, so it works on a bench board with nothing attached.

	  The board's -u-boot.dtsi must add a 'dptx' image node AND name it in
	  fit,firmware BEFORE "u-boot". A node that is present but not named
	  there is emitted into the FIT and never loaded, and SPL stages every
	  COMPRESSED image through CONFIG_SYS_LOAD_ADDR -- which is inside
	  decompressed U-Boot -- so a compressed node listed after "u-boot"
	  lands on live .text. See the LANDMINE comments in the board DTSI.

	  The board DTSI must ALSO set fit,firmware-strict on that
	  configuration. binman picks `firmware` as the first name in
	  fit,firmware that is VALID, not the first name, so with dptx listed
	  before "u-boot" a build with no rockchip/bl31.elf would make atf-1
	  invalid, elect dptx as the boot image, and SPL would treat the ucpu
	  blob as U-Boot (reproduced). With the directive binman refuses that
	  build outright, naming the missing entry. Do not "fix" the ordering
	  instead: with LZMA kept, listing dptx after "u-boot" breaks the
	  HEALTHY build too.

config CDN_DP_FW_SCRIPT
	bool "U-Boot environment script (filesystem or TFTP)"
	depends on SUPPORTS_FW_LOADER
	select FW_LOADER
	help
	  Load dptx.bin at runtime via lib/fw_loader.c, by running an
	  environment script named 'cdn_dp_fw'. This keeps the blob a separate,
	  unmodified, merely-aggregated file, which is what sidesteps
	  LICENCE.rockchip's patent grant covering the software "alone, or in
	  combination with an operating system" -- a bootloader is arguably not
	  an operating system. It is the licence escape hatch, and it costs no
	  image bytes.

	  It needs an operator to publish the file. ROC-RK3399-PC has no
	  onboard storage and cannot saveenv (ENV_IS_IN_FAT with no MMC), so in
	  practice every boot needs a fetch and a re-entered script. This
	  U-Boot has no CONFIG_CMD_NFS, so the fleet route is TFTP:

	    setenv cdn_dp_fw 'dhcp ${loadaddr} rk3399/dptx.bin && \
	        setenv cdn_dp_fw_addr ${fileaddr} && \
	        setenv cdn_dp_fw_size ${filesize}'

	  NOTE the variable names. include/fw_loader.h documents 'fw_addr' and
	  'fw_size', but lib/fw_loader.c builds "%s_addr"/"%s_size" from the
	  script name. A script following the header comment silently yields
	  -EINVAL.

	  ${loadaddr} is 0x800800 here (include/env_default.h defines
	  loadaddr from CONFIG_SYS_LOAD_ADDR; the board sets no CONFIG_LOADADDR
	  and does not need to). That is the same address as CONFIG_TEXT_BASE +
	  2 KiB, and it is NOT the hazard it looks like: this script runs from
	  the U-Boot prompt, long after relocation moved the monitor to the top
	  of DRAM (board_get_usable_ram_top(), ~0xf8000000), so 0x800800 is
	  ordinary free DRAM by then. Nor does the buffer have to survive:
	  request_firmware_into_buf_via_script() memcpy()s the blob into a
	  driver-owned buffer on the line after the script returns.

	  Do not carry the SPL rule over to here. The board's -u-boot.dtsi
	  argues at length that 0x800800 is dangerous, and it is -- in SPL,
	  where decompressed U-Boot really is live at CONFIG_TEXT_BASE while
	  the FIT is still being unpacked around it. The two contexts share an
	  address and share nothing else.

endchoice

config CDN_DP_FW_FIT_ADDR
	hex "Address SPL decompressed dptx.bin to"
	depends on CDN_DP_FW_FIT
	default 0x00400000
	help
	  Must equal the 'load' property of the FIT's dptx node. The board DTSI
	  takes this symbol directly, so the two cannot drift.

	  0x00400000 sits in the free window [0x202000, 0x800000): above the
	  SPL FIT structure at CONFIG_SPL_LOAD_FIT_ADDRESS, below
	  CONFIG_TEXT_BASE, and clear of TZRAM, BL31, the SCMI shmem and
	  U-Boot's pre-relocation stack at CONFIG_CUSTOM_SYS_INIT_SP_ADDR.

	  The buffer is NOT reserved from Linux. It only has to survive
	  SPL -> cdn_dp probe and must not be relied on after booti.

config CMD_CDN_DP
	bool "cdn_dp bring-up command"
	depends on DISPLAY_ROCKCHIP_DP
	help
	  A 'cdn_dp' command for driving the DisplayPort controller by hand
	  during bring-up, so it can be exercised without being wired into the
	  VOP's output-port walk. Scaffolding; remove once DP comes up on its
	  own.

config DISPLAY_ROCKCHIP_EDP
	bool "EDP Port"
	depends on VIDEO_ROCKCHIP
	help
	  This enables Embedded DisplayPort(EDP) display support.

config DISPLAY_ROCKCHIP_LVDS
	bool "LVDS Port"
	depends on VIDEO_ROCKCHIP
	help
	  This enables Low-voltage Differential Signaling(LVDS) display
	  support.

config DISPLAY_ROCKCHIP_HDMI
	bool "HDMI port"
	select VIDEO_DW_HDMI
	depends on VIDEO_ROCKCHIP
	help
	  This enables High-Definition Multimedia Interface display support.

config DISPLAY_ROCKCHIP_MIPI
	bool "MIPI Port"
	depends on VIDEO_ROCKCHIP
	help
	  This enables Mobile Industry Processor Interface(MIPI) display
	  support. The mipi controller and dphy on rk3288& rk3399 support
	  16,18, 24 bits per pixel with up to 2k resolution ratio.

config DISPLAY_ROCKCHIP_DW_MIPI
	bool "Rockchip Designware MIPI"
	depends on VIDEO_ROCKCHIP
	select VIDEO_DW_MIPI_DSI
	help
	  Select the Designware MIPI DSI controller in use on some Rockchip
	  SOCs.

endif
```

## test/libre-computer/test-console.its
```
/dts-v1/;

/ {
	description = "Libre Computer U-Boot hardware test";
	#address-cells = <1>;

	images {
		script-1 {
			description = "hwtest";
			type = "script";
			compression = "none";
			data = /incbin/("test-console.txt");
			hash {
				algo = "sha256";
			};
		};
	};

	configurations {
		default = "conf-1";
		conf-1 {
			description = "hwtest";
			script = "script-1";
		};
	};
};
```
