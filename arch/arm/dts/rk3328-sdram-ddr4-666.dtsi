// SPDX-License-Identifier: (GPL-2.0+ OR MIT)
// Copyright (c) 2018 Fuzhou Rockchip Electronics Co., Ltd.

#include <asm/arch-rockchip/sdram_rk3328_ddr4_666.h>

#define RK3328_SDRAM_DT_CELL(c) c

&dmc {
	rockchip,sdram-params = < RK3328_SDRAM_DDR4_666(RK3328_SDRAM_DT_CELL) >;
};
