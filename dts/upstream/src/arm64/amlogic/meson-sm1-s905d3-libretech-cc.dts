// SPDX-License-Identifier: (GPL-2.0+ OR MIT)
/*
 * Copyright (c) 2023 BayLibre, SAS.
 * Author: Jerome Brunet <jbrunet@baylibre.com>
 *
 * AML-S905D3-CC on the VENDOR firmware chain. The libre chain boots
 * meson-sm1-s905d3-libretech-cc-libre.dts instead.
 */

/dts-v1/;

#include "meson-sm1-s905d3-libretech-cc.dtsi"
#include "meson-g12-vendor-firmware.dtsi"
#include "meson-libretech-ramoops.dtsi"

/*
 * The vendor chain's CPU description: clk-based OPPs driven by cpufreq-dt.
 * It lives in this leaf, not in meson-sm1.dtsi or the shared -cc.dtsi, so
 * the -libre leaves carry no OPP table (their SC owns sys_pll).
 */
&cpu0 {
	operating-points-v2 = <&cpu_opp_table>;
	clocks = <&clkc CLKID_CPU_CLK>;
	cpu-supply = <&vddcpu_b>;
	clock-latency = <50000>;
};

&cpu1 {
	operating-points-v2 = <&cpu_opp_table>;
	clocks = <&clkc CLKID_CPU1_CLK>;
	cpu-supply = <&vddcpu_b>;
	clock-latency = <50000>;
};

&cpu2 {
	operating-points-v2 = <&cpu_opp_table>;
	clocks = <&clkc CLKID_CPU2_CLK>;
	cpu-supply = <&vddcpu_b>;
	clock-latency = <50000>;
};

&cpu3 {
	operating-points-v2 = <&cpu_opp_table>;
	clocks = <&clkc CLKID_CPU3_CLK>;
	cpu-supply = <&vddcpu_b>;
	clock-latency = <50000>;
};
