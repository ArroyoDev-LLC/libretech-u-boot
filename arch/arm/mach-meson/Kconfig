## board/libre-computer/roc-rk3328-cc/Kconfig
```kconfig
if TARGET_ROC_RK3328_CC

config SYS_BOARD
	string "Board name"
	default "roc-rk3328-cc"
	help
	  The board directory under board/libre-computer/ and the name of
	  the built-in splash logo (<board>.bmp) tools/Makefile bakes in.
	  Prompted so a defconfig for a board variant that shares this
	  directory (roc-rk3328-cc-v2, a symlink to it) can name its own
	  logo; without a prompt the defconfig's CONFIG_SYS_BOARD line is
	  silently dropped.

config SYS_VENDOR
	default "libre-computer"

config SYS_CONFIG_NAME
	default "roc-rk3328-cc"

endif
```

## board/libre-computer/roc-rk3399-pc/Kconfig
```kconfig
if TARGET_ROC_PC_RK3399

config SYS_BOARD
	default "roc-rk3399-pc"

config SYS_VENDOR
	default "libre-computer"

config SYS_CONFIG_NAME
	default "roc-rk3399-pc"

config ROC_RK3399_PC_REVFIX
	bool "Detect the board revision from the LPDDR4 rank count and fix up the kernel DT"
	default y
	select OF_BOARD_SETUP
	help
	  ROC-RK3399-PC V1.2A carries two 200-ball LPDDR4 packages (one rank
	  per channel); V1.0 / V1.1-A carry one 366-pin package (two ranks per
	  channel). TPL publishes the detected rank in PMUGRF_OS_REG2, so the
	  revision is readable here without any strap or ID resistor. One
	  rank is reported as v1.2. Two ranks are reported as v1.1: that
	  population shipped as V1.1-A, and a V1.0 reads the same. This
	  sets $board_rev, prints the revision, and in ft_board_setup()
	  prepends libre-computer,roc-rk3399-pc-v1.2 or -v1.1 to the root
	  compatible. On a V1.2A it also
	  replaces the mps,mp8859 node's dc_12v with a root regulator-fixed
	  (the V1.2A part is an SC8903 with no i2c and no SoC-driven enable),
	  re-pointing sys_12v at it and disabling the mp8859 node.

config ROC_RK3399_PC_CPU_L_MHZ
	int "U-Boot proper's little-cluster clock in MHz (0: leave it at 600)"
	depends on ROC_RK3399_PC_REVFIX
	default 0
	help
	  0, 1008, 1200 or 1416. U-Boot runs on an A53 that the clock setup
	  leaves at 600 MHz; work bound by that core (LZMA unpacking a DFU
	  download, hashing, decompressing a kernel) scales with its clock.
	  Proper raises vdd_cpu_l to the RK3399 cluster-0 OPP voltage for the
	  rate first (925 / 1000 / 1125 mV, Linux rk3399.dtsi), then the PLL.
	  The kernel's cpufreq takes over from there. An SPL with the RK808
	  (SPL_REGULATOR_RK8XX) does the same before its MaskROM USB flash
	  session.

config ROC_RK3399_PC_BENCH_CLKCAP
	bool "bench_clkcap env: cap the kernel DT's CPU/GPU OPP tables (bench only)"
	depends on ROC_RK3399_PC_REVFIX
	default y
	help
	  When the environment variable bench_clkcap is set to 1,
	  ft_board_setup() deletes every opp-* node above 816 MHz from the
	  arm,cortex-a53 OPP table, above 1008 MHz from the arm,cortex-a72
	  table and above 500 MHz from the arm,mali-t860 table of the device
	  tree handed to the OS (booti/bootm and the EFI path alike), so a
	  foreign kernel on a hub-VBUS-powered bench cannot brown the rail
	  out. Nodes are judged by opp-hz, not by name. Unset, nothing
	  happens: the product boot is unaffected. Never set bench_clkcap in
	  a defconfig or a product environment.

config ROC_RK3399_PC_REVFIX_CMD
	bool "roc_revfix_test command (bench only)"
	depends on ROC_RK3399_PC_REVFIX
	default n
	help
	  Adds `roc_revfix_test <fdt_addr>`, which runs ft_board_setup() on a
	  device tree blob at that address so the fixup can be inspected with
	  `fdt print` on a board with nothing to boot. Never enable this in a
	  product defconfig.

endif
```

## board/mediatek/genio-510-evk/Kconfig
```kconfig
if TARGET_MT8188

config SYS_BOARD
	default "genio-510-evk"

config SYS_CONFIG_NAME
	default "mt8188"

endif
```

## board/mediatek/med-mt88-mx-g5/Kconfig
```kconfig
if TARGET_MT8188

config SYS_BOARD
	default "med-mt88-mx-g5"

config SYS_CONFIG_NAME
	default "mt8188"

endif
```

## board/xilinx/zynq/Kconfig
```kconfig
# SPDX-License-Identifier: GPL-2.0
#
# Copyright (c) 2018, Xilinx, Inc.

if ARCH_ZYNQ

config ZYNQ_ADRV9009
	bool "HamGeek/RIGUKE XC7Z100 + ADRV9009 board-specific code"
	select BINMAN
	help
	  Build board/xilinx/zynq/zynq-adrv9009/board.c into U-Boot proper. It
	  supplies misc_init_r(), which derives a deterministic ethaddr and
	  serial# from the QSPI NOR factory unique ID (see the file header for
	  the full fallback chain), and set_dfu_alt_info(), the QSPI NOR DFU
	  alternate-setting map. Without it the board takes a fresh random MAC
	  on every boot and Linux loses its permanent MAC.

	  Also selects BINMAN, which packs spl/boot.bin + u-boot.img into the
	  single SPI NOR bootloader blob u-boot-zynq-nor.bin described by
	  arch/arm/dts/zynq-adrv9009-u-boot.dtsi. ARCH_ZYNQ does not select
	  BINMAN (only ARCH_ZYNQMP does), so without this the binman node is
	  never processed and the build silently emits two loose artifacts.

config ZYNQ_E310
	bool "HamGeek/ANTSDR E310 board-specific code"
	select BINMAN
	help
	  Build board/xilinx/zynq/zynq-e310/board.c into U-Boot proper. It
	  supplies misc_init_r(), which derives a deterministic ethaddr from
	  the QSPI NOR factory unique ID (see the file header for the full
	  fallback chain). Without it the board takes a fresh random MAC on
	  every boot.

	  Also selects BINMAN, which packs spl/boot.bin + u-boot.img into the
	  single SPI NOR bootloader blob u-boot-e310-nor.bin described by
	  arch/arm/dts/zynq-e310-u-boot.dtsi.

config CMD_ZYNQ
	bool "Enable Zynq specific commands"
	default y
	help
	  Enables Zynq specific commands.

config CMD_ZYNQ_AES
	bool "Enable zynq aes command for decryption of encrypted images"
	depends on CMD_ZYNQ
	depends on FPGA_ZYNQPL
	help
	  Decrypts the encrypted image present in source address
	  and places the decrypted image at destination address.

config CMD_ZYNQ_RSA
	bool "Enable zynq rsa command for loading secure images"
	default y
	depends on CMD_ZYNQ
	depends on CMD_ZYNQ_AES
	help
	  Enabling this will support zynq secure image verification.
	  The secure image is a xilinx specific BOOT.BIN with
	  either authentication or encryption or both encryption
	  and authentication feature enabled while generating
	  BOOT.BIN using Xilinx bootgen tool.

endif
```

## configs/aml-s905d3-cc_libre_resident_hb_defconfig
```kconfig
# aml-s905d3-cc_libre_resident_defconfig with the SC heartbeat opted in: PREBOOT
# copies the control FDT to ${fdt_addr_r}, sets /soc/sc-heartbeat@fffe7200
# "okay" in the copy, and points fdt_addr at it (the EFI path prefers fdt_addr
# over fdtcontroladdr).  The control FDT is never edited: an in-place edit
# shifts node offsets under the driver model (no live tree), and a device
# probed later reads a stale node (meson-rng: readl(~0) at EFI boot).  Pairs
# with an SC built SCP_G12A_AP_HEARTBEAT=ON.  Generated by savedefconfig.
# LBS target aml-s905d3-cc-libre-resident-hb.
# Plan: claude amlogic/software/boot/g12/plan/sm1-two-stage-watchdog.md "Landing".
CONFIG_ARM=y
CONFIG_SYS_VENDOR="libre-computer"
CONFIG_SYS_BOARD="aml-s905d3-cc"
CONFIG_COUNTER_FREQUENCY=24000000
CONFIG_ARCH_MESON=y
CONFIG_TEXT_BASE=0x01000000
CONFIG_SYS_MALLOC_LEN=0x8000000
CONFIG_SPL_LIBCOMMON_SUPPORT=y
CONFIG_ENV_SOURCE_FILE="../common/boot"
CONFIG_NR_DRAM_BANKS=1
CONFIG_HAS_CUSTOM_SYS_INIT_SP_ADDR=y
CONFIG_CUSTOM_SYS_INIT_SP_ADDR=0x20000000
CONFIG_SF_DEFAULT_SPEED=100000000
CONFIG_ENV_SIZE=0x2000
CONFIG_DM_GPIO=y
CONFIG_DEFAULT_DEVICE_TREE="amlogic/meson-sm1-s905d3-libretech-cc-libre"
CONFIG_OF_LIBFDT_OVERLAY=y
CONFIG_DM_RESET=y
CONFIG_MESON_G12A=y
CONFIG_MESON_G12A_XPL_CHAIN=y
CONFIG_MESON_G12A_DRAM_OPEN=y
CONFIG_MESON_G12A_DRAM_OPEN_LIVE=y
CONFIG_TPL_MESON_G12A_USB_RESIDUAL=y
CONFIG_TPL_MESON_G12A_USB_W1_HOLD=y
CONFIG_TPL_MESON_G12A_EMMC_REG=y
CONFIG_TPL_MESON_G12A_EMMC_FETCH=y
CONFIG_MESON_G12A_RESIDENT=y
CONFIG_MESON_G12A_LIBRE_SCMI_FIXUP=y
CONFIG_MESON_G12A_LIBRE_SECURE_LAYOUT=y
CONFIG_SPL_SYS_MALLOC_F_LEN=0x8000
CONFIG_SPL_MMC=y
CONFIG_SPL_SERIAL=y
CONFIG_TPL_TEXT_BASE=0xfffa1000
CONFIG_TPL_STACK=0xfffb3000
CONFIG_TPL_SYS_MALLOC_F_LEN=0x1000
CONFIG_TPL_LIBCOMMON_SUPPORT=y
CONFIG_TPL_LIBGENERIC_SUPPORT=y
CONFIG_TPL_SERIAL=y
CONFIG_SPL_DRIVERS_MISC=y
CONFIG_SPL_STACK=0x9000000
CONFIG_SPL_TEXT_BASE=0x08000000
CONFIG_SPL_HAS_BSS_LINKER_SECTION=y
CONFIG_SPL_BSS_START_ADDR=0xfffb0000
CONFIG_SPL_BSS_MAX_SIZE=0x1000
CONFIG_SYS_LOAD_ADDR=0x1000000
CONFIG_SPL=y
CONFIG_DEBUG_UART_BASE=0xff803000
CONFIG_DEBUG_UART_CLOCK=24000000
CONFIG_IDENT_STRING=" Libre Computer AML-S905D3-CC Solitude"
CONFIG_ARMV8_UDELAY_EVENT_STREAM=y
CONFIG_ARMV8_CRYPTO=y
CONFIG_TPL_MAX_SIZE=0xf000
CONFIG_TPL_SIZE_LIMIT=0xf000
CONFIG_DEBUG_UART=y
# CONFIG_LOCALVERSION_AUTO is not set
CONFIG_LTO=y
CONFIG_REMAKE_ELF=y
CONFIG_EFI_RUNTIME_UPDATE_CAPSULE=y
CONFIG_EFI_CAPSULE_ON_DISK=y
CONFIG_EFI_CAPSULE_FIRMWARE_RAW=y
CONFIG_EFI_CAPSULE_AUTHENTICATE=y
CONFIG_EFI_CAPSULE_CRT_FILE="board/libre-computer/common/eficapsule.pub.pem"
CONFIG_EFI_IP4_CONFIG2_PROTOCOL=y
CONFIG_EFI_HTTP_PROTOCOL=y
CONFIG_EFI_SCROLL_ON_CLEAR_SCREEN=y
CONFIG_EFI_HTTP_BOOT=y
# CONFIG_BOOTEFI_HELLO_COMPILE is not set
# CONFIG_BOOTEFI_TESTAPP_COMPILE is not set
CONFIG_FIT=y
CONFIG_FIT_SIGNATURE=y
CONFIG_FIT_VERBOSE=y
CONFIG_SPL_LOAD_FIT=y
CONFIG_SPL_LOAD_FIT_ADDRESS=0x02000000
CONFIG_SPL_FIT_IMAGE_POST_PROCESS=y
CONFIG_BOOTSTD_FULL=y
# CONFIG_DISTRO_DEFAULTS is not set
CONFIG_BOOTDELAY=1
CONFIG_AUTOBOOT_USE_MENUKEY=y
CONFIG_AUTOBOOT_MENUKEY=27
CONFIG_OF_BOARD_SETUP=y
CONFIG_BOOTCOMMAND="bootflow scan -lb; pause \"No bootable device found. Press any key for menu...\"; run menucmd"
CONFIG_USE_PREBOOT=y
CONFIG_PREBOOT="run bootcmd_usbdfu; usb start; fdt move ${fdtcontroladdr} ${fdt_addr_r} 0x40000; fdt set /soc/sc-heartbeat@fffe7200 status okay; setenv fdt_addr ${fdt_addr_r};"
CONFIG_BOARD_CONFIG=y
CONFIG_SILENT_CONSOLE=y
# CONFIG_SPL_SILENT_CONSOLE is not set
# CONFIG_TPL_SILENT_CONSOLE is not set
CONFIG_SILENT_U_BOOT_ONLY=y
CONFIG_SILENT_CONSOLE_UNTIL_ENV=y
CONFIG_SYS_CONSOLE_INFO_QUIET=y
# CONFIG_DISPLAY_CPUINFO is not set
# CONFIG_DISPLAY_BOARDINFO is not set
# CONFIG_SPL_CYCLIC is not set
CONFIG_MISC_INIT_R=y
CONFIG_SPL_MAX_SIZE=0x40000
CONFIG_SPL_BOARD_INIT=y
CONFIG_SPL_LEGACY_IMAGE_FORMAT=y
# CONFIG_SPL_SHARES_INIT_SP_ADDR is not set
CONFIG_SPL_HAVE_INIT_STACK=y
CONFIG_SPL_SYS_MALLOC=y
CONFIG_SPL_HAS_CUSTOM_MALLOC_START=y
CONFIG_SPL_CUSTOM_SYS_MALLOC_ADDR=0xa000000
CONFIG_SPL_SYS_MALLOC_SIZE=0x2000000
CONFIG_SPL_SYS_MMCSD_RAW_MODE=y
CONFIG_SYS_MMCSD_RAW_MODE_U_BOOT_SECTOR=0x100
# CONFIG_SYS_MMCSD_FS_BOOT is not set
CONFIG_SPL_DM_RESET=y
CONFIG_SPL_RAM_DEVICE=y
CONFIG_SPL_ATF=y
CONFIG_TPL=y
CONFIG_TPL_SYS_MALLOC_SIMPLE=y
CONFIG_TPL_HAVE_INIT_STACK=y
CONFIG_SYS_MAXARGS=32
# CONFIG_CMD_BDI is not set
CONFIG_CMD_SMBIOS=y
# CONFIG_BOOTM_PLAN9 is not set
# CONFIG_BOOTM_RTEMS is not set
# CONFIG_BOOTM_VXWORKS is not set
CONFIG_CMD_BOOTMENU=y
# CONFIG_CMD_IMI is not set
CONFIG_CMD_NVEDIT_EFI=y
CONFIG_CMD_BINOP=y
CONFIG_CRC32_VERIFY=y
CONFIG_CMD_MD5SUM=y
CONFIG_MD5SUM_VERIFY=y
CONFIG_CMD_SHA1SUM=y
CONFIG_SHA1SUM_VERIFY=y
CONFIG_CMD_ADC=y
CONFIG_CMD_DFU=y
CONFIG_CMD_GPIO=y
CONFIG_CMD_GPIO_READ=y
CONFIG_CMD_GPT=y
CONFIG_CMD_I2C=y
# CONFIG_CMD_LOADS is not set
CONFIG_CMD_LSBLK=y
CONFIG_CMD_MBR=y
CONFIG_CMD_MMC=y
CONFIG_CMD_MMC_REG=y
CONFIG_MMC_SPEED_MODE_SET=y
CONFIG_CMD_POWEROFF=y
CONFIG_CMD_READ=y
CONFIG_CMD_SPI=y
CONFIG_CMD_USB=y
CONFIG_CMD_USB_MASS_STORAGE=y
CONFIG_CMD_UMS_ABORT_KEYED=y
CONFIG_CMD_WDT=y
CONFIG_CMD_WRITE=y
CONFIG_CMD_CAT=y
CONFIG_CMD_SETEXPR_FMT=y
CONFIG_CMD_BMP=y
CONFIG_CMD_EFIDEBUG=y
CONFIG_CMD_INI=y
CONFIG_CMD_PAUSE=y
CONFIG_CMD_RNG=y
CONFIG_CMD_KASLRSEED=y
CONFIG_CMD_SYSBOOT=y
CONFIG_CMD_REGULATOR=y
CONFIG_CMD_HASH=y
CONFIG_HASH_VERIFY=y
# CONFIG_SPL_EFI_PARTITION is not set
CONFIG_PARTITION_TYPE_GUID=y
CONFIG_OF_CONTROL=y
CONFIG_SPL_OF_CONTROL=y
CONFIG_ENV_IS_NOWHERE=y
CONFIG_ENV_IS_IN_FAT=y
CONFIG_ENV_FAT_DEVICE_AND_PART=":auto"
CONFIG_ENV_RELOC_GD_ENV_ADDR=y
CONFIG_NET_LWIP=y
CONFIG_NET_RANDOM_ETHADDR=y
CONFIG_SPL_DM=y
CONFIG_SPL_DM_SEQ_ALIAS=y
CONFIG_SPL_SYSCON=y
CONFIG_SPL_OF_TRANSLATE=y
# CONFIG_OFNODE_MULTI_TREE is not set
CONFIG_SARADC_MESON=y
CONFIG_LBA48=y
CONFIG_SYS_64BIT_LBA=y
CONFIG_BUTTON=y
CONFIG_BUTTON_ADC=y
CONFIG_SPL_CLK=y
CONFIG_CLK_SCMI=y
CONFIG_DFU_TIMEOUT=y
CONFIG_DFU_MMC=y
CONFIG_DFU_RAM=y
CONFIG_DFU_SF=y
CONFIG_SET_DFU_ALT_INFO=y
CONFIG_SCMI_FIRMWARE=y
CONFIG_SCMI_BASE_PROBE_OPTIONAL=y
# CONFIG_SCMI_AGENT_SMCCC is not set
CONFIG_DM_I2C=y
# CONFIG_SPL_DM_I2C is not set
CONFIG_SYS_I2C_MESON=y
CONFIG_LED=y
CONFIG_LED_GPIO=y
CONFIG_DM_MAILBOX=y
CONFIG_MESON_MHU=y
CONFIG_SUPPORT_EMMC_RPMB=y
CONFIG_SUPPORT_EMMC_BOOT=y
CONFIG_MMC_MESON_GX=y
CONFIG_MTD=y
CONFIG_DM_MTD=y
CONFIG_DM_SPI_FLASH=y
CONFIG_BOOTDEV_SPI_FLASH=y
CONFIG_SPI_FLASH_SFDP_SUPPORT=y
CONFIG_SPI_FLASH_GIGADEVICE=y
CONFIG_SPI_FLASH_SPANSION=y
# CONFIG_SPI_FLASH_USE_4K_SECTORS is not set
CONFIG_DM_MDIO=y
CONFIG_DM_MDIO_MUX=y
CONFIG_ETH_DESIGNWARE_MESON8B=y
CONFIG_MDIO_MUX_MESON_G12A=y
CONFIG_PHY_REALTEK=y
CONFIG_RTL8211F_PHY_FORCE_EEE_RXC_ON=y
CONFIG_SPL_PHY=y
CONFIG_MESON_G12A_USB_PHY=y
CONFIG_PINCTRL=y
CONFIG_SPL_PINCTRL=y
CONFIG_SPL_PINCONF=y
CONFIG_PINCTRL_MESON_G12A=y
CONFIG_POWER_DOMAIN=y
CONFIG_MESON_EE_POWER_DOMAIN=y
CONFIG_DM_REGULATOR=y
CONFIG_DM_REGULATOR_FIXED=y
# CONFIG_SPECIFY_CONSOLE_INDEX is not set
# CONFIG_SPL_SERIAL_PRESENT is not set
CONFIG_DEBUG_UART_ANNOUNCE=y
CONFIG_DEBUG_UART_SKIP_INIT=y
CONFIG_MESON_SERIAL=y
CONFIG_SPI=y
CONFIG_DM_SPI=y
CONFIG_MESON_SPIFC=y
CONFIG_SYSINFO=y
CONFIG_SYSINFO_SMBIOS=y
CONFIG_SYSRESET_CMD_POWEROFF=y
CONFIG_USB=y
CONFIG_DM_USB_GADGET=y
CONFIG_SPL_DM_USB_GADGET=y
CONFIG_USB_XHCI_HCD=y
CONFIG_USB_XHCI_DWC3=y
CONFIG_USB_DWC3=y
# CONFIG_USB_DWC3_GADGET is not set
CONFIG_USB_DWC3_MESON_G12A=y
CONFIG_USB_KEYBOARD=y
CONFIG_USB_GADGET=y
CONFIG_SPL_USB_GADGET=y
CONFIG_USB_GADGET_MANUFACTURER="Libre Computer"
CONFIG_USB_GADGET_PRODUCT="Solitude"
CONFIG_USB_GADGET_VENDOR_NUM=0x1b8e
CONFIG_USB_GADGET_PRODUCT_NUM=0xfada
CONFIG_USB_GADGET_DWC2_OTG=y
CONFIG_USB_GADGET_DWC2_OTG_PHY_BUS_WIDTH_8=y
CONFIG_USB_GADGET_VBUS_DRAW=500
CONFIG_USB_GADGET_DOWNLOAD=y
CONFIG_USB_FUNCTION_ACM=y
CONFIG_USB_FUNCTION_ACM_LINUX_GADGET_ID=y
CONFIG_USB_GADGET_DNL_ACM=y
CONFIG_SPL_DFU=y
CONFIG_SPL_DFU_MMC=y
CONFIG_SPL_DFU_VIRT=y
CONFIG_SPL_USB_FUNCTION_MASS_STORAGE=y
CONFIG_SPL_USB_GADGET_DNL_ACM=y
CONFIG_VIDEO=y
CONFIG_VIDEO_LOGO=y
CONFIG_SYS_WHITE_ON_BLACK=y
CONFIG_VIDEO_MESON=y
CONFIG_I2C_EDID_STANDARD=y
CONFIG_VIDEO_DT_SIMPLEFB=y
CONFIG_SPLASH_SCREEN=y
CONFIG_SPLASH_SCREEN_ALIGN=y
CONFIG_HIDE_LOGO_VERSION=y
CONFIG_VIDEO_BMP_GZIP=y
CONFIG_BMP_16BPP=y
CONFIG_BMP_24BPP=y
CONFIG_BMP_32BPP=y
# CONFIG_WATCHDOG_AUTOSTART is not set
CONFIG_WDT=y
CONFIG_WDT_MESON_GXBB=y
CONFIG_DYNAMIC_CRC_TABLE=y
# CONFIG_RANDOM_UUID is not set
CONFIG_SPL_CRC32=y
# CONFIG_SPL_SHA1 is not set
# CONFIG_SPL_SHA256 is not set
CONFIG_SPL_LZMA=y
# CONFIG_VPL_LZMA is not set
```
