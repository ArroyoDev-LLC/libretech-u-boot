// SPDX-License-Identifier: (GPL-2.0+ OR MIT)
/*
 * Libre Computer AML-A311D-CM-V01 (V0.1 prototype)
 *
 * Hardware is electrically identical to V1 (V0.2) for DT purposes.
 * Same power tree, same PMICs, same GPIOs, same ETH PHY.
 */

/dts-v1/;

#include "meson-g12b-a311d.dtsi"
#include "meson-libretech-cottonwood-cm.dtsi"
#include "meson-g12b-libretech-cottonwood-cm.dtsi"
#include "meson-g12-vendor-firmware.dtsi"

/ {
	compatible = "libretech,aml-a311d-cm-v01", "amlogic,a311d", "amlogic,g12b";
	model = "Libre Computer AML-A311D-CM-V01";
};

/ {
	reserved-memory {
		linux,cma {
			/*
			 * AML-A311D-CM-V01 comes in up to 4 GiB RAM variants. Set
			 * CMA to 896 MiB (max formula for 4 GiB). U-boot caps to
			 * min(DT, calculated) based on detected RAM.
			 */
			size = <0x0 0x38000000>;
		};
	};
};
